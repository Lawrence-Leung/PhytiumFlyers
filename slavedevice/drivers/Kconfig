## sourcecode/slavedevice/example/system/amp/openamp/core0/Kconfig
```kconfig
#
# For a description of the syntax of this configuration file,
# see tools/kconfiglib/kconfig-language.txt.
#


mainmenu "Phytium Freertos Configuration"

	menu "Project Configuration"

		menu " Freertos Configuration"
		config TARGET_NAME
			string "Build Target Name"
			default "openamp_core0"
			help
				Build Target name for the demo
	
		config SHM_BASE_ADDR
			hex "Share memory address set"
			default 0xc0000000

	endmenu


	menu "AMP Config"

		config IPI_IRQ_NUM
			int "Communication interruption number between multiple cores"
			default 0
		
		config IPI_IRQ_NUM_PRIORITY
			int "Priority of internuclear communication interruption"
			default 16
		
		config SPIN_MEM
			hex "Spin-lock shared memory"
			default 0x80000000

		config TARGET_CPU_ID
			int "Destination CPU id"
			default 1

		config IPI_CHN_BITMASK
			int "Destination IPI mask"
			default 1
			help
				Each bit represents a CPU, for example, 0x3 represents CPU 0 and CPU 3 in the code.
		
		config DEBUG_CODE
			bool
			prompt "DEBUG_CODE"
			default 1
			help
				Debug mode means using two bare metal code to simulate the operation of OpenAMP program
		
	endmenu
	
endmenu

source "$(SDK_DIR)/../freertos.kconfig"
```

## sourcecode/slavedevice/example/system/amp/openamp/core1/Kconfig
```kconfig
#
# For a description of the syntax of this configuration file,
# see tools/kconfiglib/kconfig-language.txt.
#


mainmenu "Phytium Freertos Configuration"

	menu "Project Configuration"

		menu " Freertos Configuration"
		config TARGET_NAME
			string "Build Target Name"
			default "openamp_core1"
			help
				Build Target name for the demo
	
		config SHM_BASE_ADDR
			hex "Share memory address set"
			default 0xc0000000

	endmenu

	
	menu "Amp Config"


		config IPI_IRQ_NUM
			int "Communication interruption number between multiple cores"
			default 0
		
		config IPI_IRQ_NUM_PRIORITY
			int "Priority of internuclear communication interruption"
			default 16
		
		config SPIN_MEM
			hex "Spin-lock shared memory"
			default 0x80000000

		config IPI_CHN_BITMASK
			int "Destination IPI mask"
			default 2
			help
				Each bit represents a CPU, for example, 0x3 represents CPU 0 and CPU 3 in the code.
		

	endmenu
	
endmenu

source "$(SDK_DIR)/../freertos.kconfig"
```

## sourcecode/slavedevice/standalone/drivers/iomux/Kconfig
```kconfig
config ENABLE_IOCTRL
    bool
    default y if TARGET_FT2004 || TARGET_D2000
    prompt "Enable ioctrl"

config ENABLE_IOPAD
    bool
    default y if TARGET_E2000Q || TARGET_E2000D || TARGET_E2000S || TARGET_PHYTIUMPI
    prompt "Enable iopad"
```

## sourcecode/slavedevice/standalone/third-party/fatfs-0.1.4/port/Kconfig
```kconfig
config FATFS_RAM_DISK
    bool "RAM"
    default y
    help
        Support Fatfs in RAM storage

if FATFS_RAM_DISK
    menu "RAM Disk Configuration"
        config FATFS_RAM_DISK_BASE
            hex "Base address/Hex"
            default 0xa0000000
            help
                Setup start address of RAM Disk

        config FATFS_RAM_DISK_SIZE_MB
            int "Total size/MB"
            default 500
            help
                Setup space size of RAM Disk

        config FATFS_RAM_DISK_SECTOR_SIZE_BYTE
            int "Sector size/B"
            default 512
            help
                Setup sector size of RAM Disk

    endmenu
endif
config FATFS_SDMMC
    bool

config FATFS_SDMMC_FSDIO_TF
    bool "MicroSD(TF)(FSDIO)"
    default n
    select FATFS_SDMMC
    help
        Support Fatfs in SD storage

config FATFS_SDMMC_FSDIO_EMMC
    bool "eMMC(FSDIO)"
    default n
    select FATFS_SDMMC
    help
        Support Fatfs in eMMC storage

config FATFS_SDMMC_FSDMMC_TF
    bool "MicroSD(TF)(FSDMMC)"
    default n
    select FATFS_SDMMC
    help
        Support Fatfs in SD storage

config FATFS_SATA_DISK
    bool "SATA"
    default n
    help
        Support Fatfs in SATA storage

if FATFS_SATA_DISK
    menu "SATA Disk Configuration"
        config FATFS_FSATA
            bool "Sata_controller"
            default n
            select USE_SATA
            select ENABLE_FSATA
            help
            Support Fatfs in Sata_controller storage

        config FATFS_FSATA_PCIE
            bool "Sata_pcie"
            default n
            select USE_PCIE
            select ENABLE_F_PCIE
            select USE_SATA
            select ENABLE_FSATA
            help
            Support Fatfs in Sata_Pcie storage
    endmenu
endif

config FATFS_USB
    bool "USB"
    default n
    help
        Support Fatfs in USB Mass storage
```
