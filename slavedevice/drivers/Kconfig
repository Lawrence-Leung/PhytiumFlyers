## slavedevice/drivers/Kconfig
```kconfig
menu "Freertos Uart Drivers"
    config FREERTOS_USE_UART
        bool
        prompt "Use Freertos uart driver"
        default n
endmenu

menu "Freertos Pwm Drivers"
    config FREERTOS_USE_PWM
        bool
        prompt "Use Freertos pwm driver"
        default n
        select USE_PWM
        select USE_FPWM
endmenu

menu "Freertos Qspi Drivers"
    config FREERTOS_USE_QSPI
        bool
        prompt "Use Freertos qspi driver"
        default n
        select USE_QSPI
        select USE_FQSPI
endmenu

menu "Freertos Wdt Drivers"
    config FREERTOS_USE_WDT
        bool
        prompt "Use Freertos wdt driver"
        default n
        select USE_WDT
        select USE_FWDT
endmenu

menu "Freertos Eth Drivers"
    config FREERTOS_USE_XMAC
        select ENABLE_FXMAC
        bool
        prompt "Use Freertos xmac driver"
        default n
    
    config FREERTOS_USE_GMAC
        select ENABLE_FGMAC
        bool
        prompt "Use Freertos gmac driver"
        default n
endmenu

menu "Freertos Gpio Drivers"
    config FREERTOS_USE_GPIO
    bool
    prompt "Use Freertos gpio driver"
    default n
endmenu

menu "Freertos Spim Drivers"
    config FREERTOS_USE_FSPIM
        bool
        prompt "Use Freertos spim driver"
        default n
        select USE_SPI
        select USE_FSPIM
endmenu

menu "Freertos DMA Drivers"
    config FREERTOS_USE_FDDMA
        bool
        prompt "Use Freertos ddma driver"
        default n

    config FREERTOS_USE_FGDMA
        bool
        prompt "Use Freertos gdma driver"
        default n
endmenu

menu "Freertos Adc Drivers"
    config FREERTOS_USE_ADC
        bool
        prompt "Use Freertos adc driver"
        default n
        select USE_ADC
        select USE_FADC
endmenu

menu "Freertos Can Drivers"
    config FREERTOS_USE_CAN
        bool
        prompt "Use Freertos can driver"
        default n
        select USE_CAN
        select USE_FCAN
endmenu

menu "Freertos I2c Drivers"
    config FREERTOS_USE_I2C
        bool
        prompt "Use Freertos i2c driver"
        default n
endmenu

menu "Freertos Mio Drivers"
    config FREERTOS_USE_MIO
        bool
        prompt "Use Freertos mio driver"
        default n
endmenu

menu "Freertos Timer Drivers"
    config FREERTOS_USE_TIMER
        bool
        prompt "Use Freertos timer driver"
        default n
endmenu

menu "Freertos Media Drivers"
    config FREERTOS_USE_MEDIA
        bool
        prompt "Use Freertos media driver"
        default n
endmenu
```

## slavedevice/example/network/lwip_startup/Kconfig
```kconfig
mainmenu "Phytium FreeRTOS Configuration"

	source "./src/Kconfig"
	
source "$(SDK_DIR)/../freertos.kconfig"
```

## slavedevice/example/network/lwip_startup/src/Kconfig
```kconfig
menu " Lwip startup test configuration"

    config LWIP_IPV6_TEST
        bool "Enable IPv6"
        select LWIP_IPV6
        default n

    config LWIP_DHCP_TEST
        bool "Enable DHCP"
        select LWIP_DHCP_ENABLE
        default n
        
endmenu
```

## slavedevice/example/peripheral/adc/Kconfig
```kconfig
#
# For a description of the syntax of this configuration file,
# see tools/kconfiglib/kconfig-language.txt.
#


source "$(SDK_DIR)/../freertos.kconfig"
```

## slavedevice/example/storage/fatfs/Kconfig
```kconfig
mainmenu "Phytium freertos Configuration"

menu "Project Configuration"

	config FATFS_BASIC_TEST
		bool "Basic Test"
		default y

	config FATFS_SPEED_TEST
		bool "Speed Test"
		default n

	config FATFS_CYCLE_TEST
		bool "Cycle Test"
		default n

endmenu

source "$(SDK_DIR)/../freertos.kconfig"
```

## slavedevice/example/storage/qspi_spiffs/Kconfig
```kconfig
mainmenu "Phytium freertos Configuration"

source "$(SDK_DIR)/../freertos.kconfig"
```

## slavedevice/example/system/amp/openamp_for_linux/Kconfig
```kconfig
#
# For a description of the syntax of this configuration file,
# see tools/kconfiglib/kconfig-language.txt.
#


mainmenu "Phytium Baremetal Configuration"

	menu "Project Configuration"

		menu " Baremetal Configuration"
		config TARGET_NAME
			string "Build Target Name"
			default "openamp_core0"
			help
				Build Target name for the demo

	endmenu


	menu "AMP Config"

		config IPI_IRQ_NUM
			int "Communication interruption number between multiple cores"
			default 0
		
		config IPI_IRQ_NUM_PRIORITY
			int "Priority of internuclear communication interruption"
			default 16

		config IPI_CHN_BITMASK
			int "Destination IPI cpu mask"
			default 255
			help
				Each bit represents a CPU, for example, 0x3 represents CPU 0 and CPU 3 in the code.
		
	endmenu
	
endmenu



source "$(SDK_DIR)/standalone.kconfig"
```

## slavedevice/example/system/atomic/Kconfig
```kconfig
mainmenu "Phytium Baremetal Configuration"

	menu "Freertos Configuration"
	config TARGET_NAME
		string "Build Target Name"
		default "atomic"
		help
			Build Target name for the demo
	
endmenu

source "$(SDK_DIR)/../freertos.kconfig"
```

## slavedevice/example/system/exception_debug/Kconfig
```kconfig
mainmenu "Phytium Baremetal Configuration"

menu "Project Configuration"
	
	config TARGET_NAME
		string "Build Target Name"
		default "exception"
		help
			Build Target name for the demo

	choice EXCEPTION_TEST_TYPE
        prompt "exception type"
        default EXCEPTION_INVALID_INSTRUCTION
        help
            Select Transfer Mode as Poll or Intrrupt

        config EXCEPTION_INVALID_INSTRUCTION
            bool "Invalid instruction"

		config EXCEPTION_ACCESS_PERMISSION_ERROR
            bool "Memory access permission error"

        config EXCEPTION_ACCESS_VIOLATION
            bool "Memory access violation"

    endchoice #EXCEPTION_TEST_TYPE

endmenu

source "$(SDK_DIR)/../freertos.kconfig"
```

## slavedevice/standalone/drivers/media/Kconfig
```kconfig
menu "Media Configuration"
    choice
        prompt "choice fmedia driver"
        config ENABLE_FMEDIA
            bool
            prompt "Use FMEDIA" 

	if ENABLE_FMEDIA
    config ENABLE_FDC_DP
         bool
         prompt "USE FMEDIA" 

    config ENABLE_FDC_DP_USE_LIB
         bool
         prompt "USE FMEDIA LIB TO LINK"

	endif

endchoice

endmenu
```

## slavedevice/standalone/drivers/mio/Kconfig
```kconfig
menu "Hardware Mio Configuration"
    config ENABLE_MIO
        bool
        prompt "Use Mio"
        depends on TARGET_E2000 || TARGET_TARDIGRADE || TARGET_PHYTIUMPI

        default n
endmenu
```

## slavedevice/standalone/drivers/pcie/Kconfig
```kconfig
menu "Pcie Configuration"

    config ENABLE_FPCIE_ECAM
        bool
        prompt "Use fpcie ecam"
        default n

    
    config ENABLE_FPCIEC
        bool
        prompt "Use fpciec"
        default n
endmenu
```

## slavedevice/standalone/third-party/littlefs-2.4.2/Kconfig
```kconfig
menu "Littlefs configuration"

choice LITTLEFS_DEVICE_TYPE
    prompt "Select littlefs medium"
    default LITTLE_FS_ON_FSPIM_SFUD
    help
        Select medium to store LittleFS
    config LITTLE_FS_ON_FSPIM_SFUD
        bool
        prompt "Use spi nor flash(sfud)"        
        select USE_SPI
        select USE_FSPIM
        select SFUD_CTRL_FSPIM
    config LITTLE_FS_DRY_RUN
        bool
        prompt "Dry run on ram(volatile)/file(persist)"
        select USE_FATFS
        help
            Run Littlefs in emulated block device
endchoice # LITTLEFS_DEVICE_TYPE
endmenu
```

## slavedevice/standalone/third-party/sfud-1.1.0/Kconfig
```kconfig
menu "Sfud configuration"
    

    config SFUD_CTRL_FSPIM
        bool
        prompt "Use fspim"        
        select USE_SPI
        select USE_FSPIM
        default n

    if SFUD_CTRL_FSPIM
    choice SFUD_TRANS_MODE
        prompt "Trans mode"
        default SFUD_TRANS_MODE_POLL_FIFO
        help
            Select Transfer Mode as Poll or Interrupt

        config SFUD_TRANS_MODE_POLL_FIFO
            bool "Poll"

        config SFUD_TRANS_MODE_INTRRUPT
            bool "Interrupt"

    endchoice #SFUD_TRANS_MODE
    endif

    config SFUD_CTRL_FQSPI
            bool
            prompt "Use FQSPI"        
            select USE_QSPI
            select USE_FQSPI
            default n
    if SFUD_CTRL_FQSPI
    choice SFUD_QSPI_READ_MODE
        prompt "Qspi read mode"
        default SFUD_QSPI_READ_MODE_QUAD_READ
        help
            Select QSPI Read Mode as Read or Dual or Quad

        config SFUD_QSPI_READ_MODE_READ
            bool "Read"

        config SFUD_QSPI_READ_MODE_DUAL_READ
            bool "Dual read"

        config SFUD_QSPI_READ_MODE_QUAD_READ
            bool "Quad read"

    endchoice #SFUD_QSPI_READ_MODE
    endif
endmenu
```

## slavedevice/standalone/tools/build/boot_code/Kconfig
```kconfig
mainmenu "Phytium Baremetal Configuration"



source "$(SDK_DIR)/standalone.kconfig"
```

## slavedevice/standalone/tools/console/Kconfig
```kconfig
	config CONSOLE_PORT
        string "Default serial port"
        default "/dev/ttyS3"
        help
            The serial port that connected to the Phytium chip. 


    config CONSOLE_YMODEM_RECV_DEST
        string "Default ymodem receiving destination"
        default "./"
        help
            Ymodel receiver file destination. 


	choice CONSOLE_BAUD
        prompt "Default baud rate"
        default CONSOLE_BAUD_115200B
        help
            Default baud rate to use while communicating with the Phytium chip. 

        config CONSOLE_BAUD_115200B
            bool "115200 baud"
        config CONSOLE_BAUD_230400B
            bool "230400 baud"
        config CONSOLE_BAUD_921600B
            bool "921600 baud"
        config CONSOLE_BAUD_2MB
            bool "2Mbaud"
        config CONSOLE_BAUD_OTHER
            bool "Other baud rate"
    endchoice

    config CONSOLE_BAUD_OTHER_VAL
        int "Other baud rate value" if CONSOLE_BAUD_OTHER
        default 115200

    config CONSOLE_BAUD
        int
        depends on !IDF_CMAKE
        default 115200 if CONSOLE_BAUD_115200B
        default 230400 if CONSOLE_BAUD_230400B
        default 921600 if CONSOLE_BAUD_921600B
        default 2000000 if CONSOLE_BAUD_2MB
        default CONSOLE_BAUD_OTHER_VAL if CONSOLE_BAUD_OTHER

	choice CONSOLE_UPLOAD_TYPE
        prompt "Method to upload image"
        default CONSOLE_UPLOAD_YMODEM
        help
            Select the method to upload image into Phytium chip. 

        config CONSOLE_UPLOAD_TFTP
            bool "tftp(network)"
        config CONSOLE_UPLOAD_YMODEM
            bool "ymodem(serial)"
    endchoice

    if CONSOLE_UPLOAD_TFTP

	menu "TFTP upload config"
		config UBOOT_BOARD_IP
			string "Default uboot local ip"
			default "192.168.4.20"
			help
				Set the local address of the development board

		config UBOOT_HOST_IP
			string "Default uboot host ip"
			default "192.168.4.50"
			help
				Set ipv4 host address of the development board
		
		config UBOOT_GATEWAY_IP
			string "Default uboot gateway ip"
			default "192.168.4.1"
			help
				Set ipv4 address for developer host-board gateway

		config UBOOT_ELF_BOOT_ADDR
			string "Boot address to load image"
			default "0xf0000000"
			help
				Sets where development board ELF will jump

	endmenu 

    endif

    config CONSOLE_UPLOAD_DIR
        string "Folder to save uploading image"
        default "/mnt/d/tftboot"
        help
            Set where to put bin/elf image before upload

    config CONSOLE_UPLOAD_IMAGE_NAME
        string "Name of uploading image"
        default "baremetal" if USE_BAREMETAL
        help
            Set name of bin/elf image without suffix
```

## slavedevice/standalone/tools/export_sdk/Kconfig
```kconfig
mainmenu "Phytium Baremetal Configuration"

menu "Project Configuration"
	config TARGET_NAME
		string "Build Target Name"
		default "baremetal"
		help
			Build Target name for the demo
endmenu

menu "Export Configuration"
config COMPILE_DRIVER_ONLY
    bool "Compile driver only"
        default y
        help
            Compile only driver source files to test linkability

choice EXPORT_TYPE
    prompt "Select export type"
	default EXPORT_TYPE_RTT
	help	
		Select Standalone export type

    config EXPORT_TYPE_RTT
        bool "RT-Thread"

endchoice
endmenu

source "$(STANDALONE_SDK_ROOT)/Kconfig"
```

## slavedevice/third-party/cherryusb/Kconfig
```kconfig
menu "CherryUSB Configuration"
    choice CHERRY_USB_PORT_TYPE
        prompt "Select Cherry USB Port Type"
        default CHERRY_USB_PORT_XHCI
        help
            Select Port Type for CherryUSB

        config CHERRY_USB_PORT_XHCI
            bool "XHCI"

        config CHERRY_USB_PORT_PHYTIUM_OTG
            bool "OTG(Phytium)"

    endchoice # CHERRY_USB_PORT_TYPE

    choice CHERRY_USB_WORK_MODE
        prompt "Select Cherry USB Work Mode"
        help
            Select Work Mode for CherryUSB

        config CHERRYUSB_HOST
            bool "Host(Hc)"

        config CHERRYUSB_DEVICE
            bool "Device(Dc)"

    endchoice #CHERRY_USB_WORK_MODE

if CHERRYUSB_HOST
    config CHERRY_USB_HOST_HUB
        bool "HUB(Hc)"
        default y  

    config CHERRY_USB_HOST_MSC
        bool "MSC(Hc)"
        default n

    config CHERRY_USB_HOST_HID
        bool "HID(Hc)"
        default n 

    config CHERRY_USB_HOST_VEDIO
        bool "VEDIO(Hc)"
        default n

    config CHERRY_USB_HOST_CDC
        bool "CDC(Hc)"
        default n

    config CHERRY_USB_HOST_RNDIS_WIRELESS
        bool "RndisWireless(Hc)"
        default n

endif #CHERRYUSB_HOST

if CHERRYUSB_DEVICE

    choice CHERRY_USB_DEVICE_TYPE
        prompt "Select Cherry USB Device Type"
        help
            Select Device Type that Cherry USB Work as

        config CHERRY_USB_DEVICE_HUB
            bool "HUB(Dc)"

        config CHERRY_USB_DEVICE_MSC
            bool "MSC(Dc)"

        config CHERRY_USB_DEVICE_HID
            bool "HID(Dc)"

        config CHERRY_USB_DEVICE_AUDIO
            bool "Audio(Dc)"

        config CHERRY_USB_DEVICE_CDC
            bool "Cdc(Dc)"

        config CHERRY_USB_DEVICE_DFU
            bool "DFU(Dc)"

        config CHERRY_USB_DEVICE_MTP
            bool "MTP(Dc)"

        config CHERRY_USB_DEVICE_PRINTER
            bool "Printer(Dc)"

        config CHERRY_USB_DEVICE_VEDIO
            bool "Vedio(Dc)"

        config CHERRY_USB_DEVICE_RNDIS_WIRELESS
            bool "RndisWireless(Dc)"

    endchoice #CHERRY_USB_DEVICE_TYPE

endif #CHERRYUSB_DEVICE

endmenu
```

## sourcecode/slavedevice/Kconfig
```kconfig
# entry of menuconfig
# mainmenu "Phytium FreeRTOS SDK Configuration"

STANDALONE_DIR := $(FREERTOS_STANDALONE)

menu "Standalone Setting"
    config USE_FREERTOS
        bool "Building FreeRTOS Application"
        default y
        help
            Building FreeRTOS Application

    source "$(STANDALONE_DIR)/arch/Kconfig"
    source "$(STANDALONE_DIR)/soc/Kconfig"
    source "$(STANDALONE_DIR)/drivers/Kconfig"
    source "$(STANDALONE_DIR)/lib/Kconfig"
endmenu

menu "Building Option"
    source "$(STANDALONE_DIR)/common/Kconfig"
    source "$(FREERTOS_SDK_ROOT)/make/ld/Kconfig"
    source "$(FREERTOS_SDK_ROOT)/make/Kconfig"

endmenu

menu "Component Configuration"  
    source "$(FREERTOS_SDK_ROOT)/drivers/Kconfig"
endmenu

menu "Third-Party Configuration"
    source "$(FREERTOS_SDK_ROOT)/third-party/Kconfig"
endmenu

menu "Kernel Configuration"
    source "$(FREERTOS_SDK_ROOT)/third-party/freertos/Kconfig"
endmenu
```

## sourcecode/slavedevice/example/freertos_feature/interrupt/Kconfig
```kconfig
#
# For a description of the syntax of this configuration file,
# see tools/kconfiglib/kconfig-language.txt.
#


mainmenu "Phytium Freertos Configuration"

source "$(SDK_DIR)/../freertos.kconfig"
```
