## sourcecode/slavedevice/third-party/freertos/Kconfig
```kconfig
    
    config FREERTOS_OPTIMIZED_SCHEDULER
        bool "Enable FreeRTOS platform optimized scheduler"
        default y
        help
            On most platforms there are instructions can speedup the ready task
            searching. Enabling this option the FreeRTOS with this instructions
            support will be built.

    config FREERTOS_HZ
        int "Tick rate (Hz)"
        range 1 1000
        default 1000
        help
            Select the tick rate at which FreeRTOS does pre-emptive context switching.
    
    config FREERTOS_MAX_PRIORITIES
        int "Max task priority"
        range 1 32
        default 32
        help
            Sets the maximum priority that can be assigned to a task. Tasks can be assigned a priority 
            from zero, which is the lowest priority, to (FREERTOS_MAX_PRIORITIES - 1), which is the highest 
            priority.
    
    config FREERTOS_KERNEL_INTERRUPT_PRIORITIES
        int "Kernel interrupt priority"
        range 1 13
        default 13
        help
            Sets the interrupt priority used by the tick interrupt, and must always be set to the 
            lowest possible interrupt priority.

    config FREERTOS_MAX_API_CALL_INTERRUPT_PRIORITIES
        int "Max api call interrupt priority"
        range 1 15
        default 11
        help
            Sets the highest interrupt priority from which interrupt-safe FreeRTOS API functions can 
            be called.


    config FREERTOS_THREAD_LOCAL_STORAGE_POINTERS
        int "Number of thread local storage pointers"
        range 1 256
        default 1
        help
            FreeRTOS has the ability to store per-thread pointers in the task
            control block. This controls the number of pointers available.

            This value must be at least 1. Index 0 is reserved for use by the pthreads API
            thread-local-storage. Other indexes can be used for any desired purpose.


    config FREERTOS_MINIMAL_TASK_STACKSIZE
        int "Minimal Task stack size"
        range 768 32768
        default 1024
        help
            The idle task has its own stack, sized in bytes. The default size is enough for most uses. Size can be
            reduced to 768 bytes if no (or simple) FreeRTOS idle hooks are used and pthread local storage or FreeRTOS
            local storage cleanup callbacks are not used.

            The stack size may need to be increased above the default if the app installs idle or thread local storage
            cleanup hooks that use a lot of stack memory.


    config FREERTOS_MAX_TASK_NAME_LEN
        int "Maximum task name length"
        range 1 256
        default 32
        help
            Changes the maximum task name length. Each task allocated will
            include this many bytes for a task name. Using a shorter value
            saves a small amount of RAM, a longer value allows more complex
            names.

            For most uses, the default of 16 is OK.


    config FREERTOS_TIMER_TASK_PRIORITY
        int "FreeRTOS timer task priority"
        range 1 25
        default 1
        help
            The timer service task (primarily) makes use of existing FreeRTOS features, allowing timer
            functionality to be added to an application with minimal impact on the size of the application's
            executable binary.

            Use this constant to define the priority that the timer task will run at.

    config FREERTOS_TIMER_TASK_STACK_DEPTH
        int "FreeRTOS timer task stack size"
        range 1536 32768
        default 2048
        help
            The timer service task (primarily) makes use of existing FreeRTOS features, allowing timer
            functionality to be added to an application with minimal impact on the size of the application's
            executable binary.

            Use this constant to define the size (in bytes) of the stack allocated for the timer task.

    config FREERTOS_TIMER_QUEUE_LENGTH
        int "FreeRTOS timer queue length"
        range 5 20
        default 10
        help
            FreeRTOS provides a set of timer related API functions. Many of these functions use a standard
            FreeRTOS queue to send commands to the timer service task. The queue used for this purpose is
            called the 'timer command queue'. The 'timer command queue' is private to the FreeRTOS timer
            implementation, and cannot be accessed directly.

            For most uses the default value of 10 is OK.

    config FREERTOS_QUEUE_REGISTRY_SIZE
        int "FreeRTOS queue registry size"
        range 0 20
        default 0
        help
            FreeRTOS uses the queue registry as a means for kernel aware debuggers to locate queues, semaphores,
            and mutexes. The registry allows for a textual name to be associated with a queue for easy identification
            within a debugging GUI. A value of 0 will disable queue registry functionality, and a value larger than 0
            will specify the number of queues/semaphores/mutexes that the registry can hold.
    
    config FREERTOS_GENERATE_RUN_TIME_STATS
        bool "Enable FreeRTOS to collect run time stats"
        default y
        select FREERTOS_USE_TRACE_FACILITY
        select FREERTOS_USE_STATS_FORMATTING_FUNCTIONS
        help
            If enabled, configGENERATE_RUN_TIME_STATS will be defined as 1 in
            FreeRTOS. This will allow FreeRTOS to collect information regarding the
            usage of processor time amongst FreeRTOS tasks. 
            The function vTaskGetRunTimeStats() will also be available
            if FREERTOS_USE_STATS_FORMATTING_FUNCTIONS and
            FREERTOS_USE_TRACE_FACILITY are enabled. vTaskGetRunTimeStats() will
            display the run time of each task as a % of the total run time of all
            CPUs (task run time / no of CPUs) / (total run time / 100 )

    config FREERTOS_USE_TRACE_FACILITY
        bool "Enable FreeRTOS trace facility"
        default n
        help
            If enabled, configUSE_TRACE_FACILITY will be defined as 1 in FreeRTOS.
            This will allow the usage of trace facility functions such as
            uxTaskGetSystemState().

    config FREERTOS_USE_STATS_FORMATTING_FUNCTIONS
        bool "Enable FreeRTOS stats formatting functions"
        depends on FREERTOS_USE_TRACE_FACILITY
        default n
        help
            If enabled, configUSE_STATS_FORMATTING_FUNCTIONS will be defined as 1 in
            FreeRTOS. This will allow the usage of stats formatting functions such
            as vTaskList().

    config FREERTOS_USE_TICKLESS_IDLE
        bool "Tickless idle support"
        default n
        help
            If power management support is enabled, FreeRTOS will be able to put
            the system into light sleep mode when no tasks need to run for a number
            of ticks. This number can be set using FREERTOS_IDLE_TIME_BEFORE_SLEEP option.
            This feature is also known as "automatic light sleep".

            Note that timers created using APIs may prevent the system from
            entering sleep mode, even when no tasks need to run.
            To skip unnecessary wake-up initialize a timer with the "skip_unhandled_events" option as true.

            If disabled, automatic light sleep support will be disabled.

    config FREERTOS_IDLE_TIME_BEFORE_SLEEP
        int "Minimum number of ticks to enter sleep mode for"
        depends on FREERTOS_USE_TICKLESS_IDLE
        default 3
        range 2 4294967295
        # Minimal value is 2 because of a check in FreeRTOS.h (search configEXPECTED_IDLE_TIME_BEFORE_SLEEP)
        help
            FreeRTOS will enter light sleep mode if no tasks need to run for this number
            of ticks.

    config FREERTOS_TOTAL_HEAP_SIZE
        int "Total amount of RAM available in the FreeRTOS heap, unit kbytes"
        range 1 65535
        default 10240
        help
            Set the total amount of RAM available in the FreeRTOS heap, unit kbytes, less than RAM_SIZE_MB.

    
    config FREERTOS_TASK_FPU_SUPPORT
        int "Use floating point support"
        default 1
        range 1 2
        help
            If set to 1, tasks are created without an FPU context and must call vPortTaskUsesFPU() to give
            themselves an FPU context before using any FPU instructions.
            If set to 2, all tasks will have an FPU context by default.
```

## sourcecode/slavedevice/third-party/letter-shell-3.1/Kconfig
```kconfig
menu "Letter Shell Configuration"
    choice LETTER_SHELL_USART_TYPE
        prompt "Usart Drivers"
        default LS_PL011_UART
        help
            Select Usart Driver for Letter Shell

        config LS_PL011_UART
            select USE_SERIAL
            select FREERTOS_USE_UART
            bool "PL011"

        if LS_PL011_UART
            choice LETTER_SHELL_USE_UART_INSTANCE
            prompt "Select Debug uart instance"
            default DEFAULT_LETTER_SHELL_USE_UART1
            help
                Select arch for build
            config DEFAULT_LETTER_SHELL_USE_UART1
                bool "Use uart1"
            config DEFAULT_LETTER_SHELL_USE_UART0
                bool "Use uart0"
            config DEFAULT_LETTER_SHELL_USE_UART2
                bool "Use uart2"
            endchoice # SHELL_USE_UART

        endif

    endchoice # LETTER_SHELL_USART_TYPE
endmenu
```

## sourcecode/slavedevice/third-party/lwip-2.1.2/Kconfig
```kconfig
menu "LWIP Freertos Port Configuration"

    source "$(STANDALONE_DIR)/third-party/lwip-2.1.2/Kconfig"
    
    menu "Tcp/ip task resource configuration"
        config LWIP_TCPIP_TASK_STACK_SIZE
            int "TCP/IP Task Stack Size"
            default 3072
            # for high log levels, tcpip_adapter API calls can end up
            # a few calls deep and logging there can trigger a stack overflow
            range 2048 65536
            help
                Configure TCP/IP task stack size, used by LWIP to process multi-threaded TCP/IP operations.
                Setting this stack too small will result in stack overflow crashes.
        
        config LWIP_TCPIP_TASK_PRIO
            int "TCP/IP Task priority"
            default 6
            help
                Configure TCP/IP task priority, used by LWIP to process multi-threaded TCP/IP operations.

        config LWIP_TCPIP_RECVMBOX_SIZE
            int "TCPIP task receive mail box size"
            default 32
            range 6 64 if !LWIP_WND_SCALE
            range 6 1024 if LWIP_WND_SCALE
            help
                Set TCPIP task receive mail box size. Generally bigger value means higher throughput
                but more memory. The value should be bigger than UDP/TCP mail box size.
    endmenu

        
    menu "lwip port thread Configuration"
        config LWIP_PORT_USE_RECEIVE_THREAD
            bool "Use Rx Thread"
            default y

        if LWIP_PORT_USE_RECEIVE_THREAD
            config LWIP_PORT_RECEIVE_THREAD_STACKSIZE
                int "the stack size of the receive thread"
                default 2048 if TARGET_ARMV8_AARCH64
                default 1024
            config LWIP_PORT_RECEIVE_THREAD_PRIORITY
                int "the priority of the receive thread"
                default 5
        endif 

        config LWIP_PORT_USE_LINK_DETECT_THREAD
            bool "Use Link detect Thread"
            default y

        if LWIP_PORT_USE_LINK_DETECT_THREAD
            config LWIP_PORT_LINK_DETECT_STACKSIZE
                int "the stack size of the mac link detect thread"
                default 2048 if TARGET_ARMV8_AARCH64
                default 1024
            config LWIP_PORT_LINK_DETECT_PRIORITY
                int "the priority of the mac link detect thread"
                default 5
        endif

        config LWIP_PORT_DHCP_THREAD
            bool "Use dhcp thread"
            default y

        if LWIP_PORT_DHCP_THREAD
            config LWIP_PORT_DHCP_STACKSIZE
                int "the stack size of the dhcp thread"
                default 4096 if TARGET_ARMV8_AARCH64
                default 2048
            config LWIP_PORT_DHCP_PRIORITY
                int "the priority of the dhcp thread"
                default 5
        endif
        
    endmenu

endmenu
```
