## sourcecode/slavedevice/standalone/third-party/lwip-2.1.2/ports/Kconfig
```kconfig
menu "LWIP Port Configuration"

    choice LWIP_GMAC_CTRL_TYPE
        prompt "Gmac Drivers"
        default LWIP_FGMAC
        help
            Select Gmac Driver for Lwip

        config LWIP_FXMAC
            select FREERTOS_USE_XMAC
            bool "FXMAC"
        
        config LWIP_FGMAC
            select FREERTOS_USE_GMAC
            bool "FGMAC"


    endchoice # LWIP_GMAC_CTRL_TYPE

    config LWIP_RX_POLL
        bool "RX_POLL_MODE"
        default n
    
endmenu
```

## sourcecode/slavedevice/standalone/third-party/openamp/ports/Kconfig
```kconfig
menu "OpenAmp"

    config USE_OPENAMP
        bool "OpenAMP Support"
        select USE_LIBMETAL
        help
            This option enables the OpenAMP library
        if USE_OPENAMP
            config USE_OPENAMP_IPI
                bool "Remoteproc use ipi"
                help
                    This configuration enables IPI working mode in OpenAMP mode

            config OPENAMP_RESOURCES_ADDR
                hex "Openamp resource address"
                default "0xa0000000"
            
            config VRING_TX_ADDR
                hex "Vring tx address"
                default "0xa0020000"

            config VRING_RX_ADDR
                hex "Vring rx address"
                default "0xa0024000"
            
            config VRING_SIZE
                hex "Vring size"
                default "0x100"
            
            config POLL_BASE_ADDR
                hex "table of base physical address of each of the pages in the I/O region"
                default "0xa0224000"
            
            config SKIP_SHBUF_IO_WRITE
                bool 
                prompt "Skip local rvdev->shbuf_io"
                help
                    rpmsg_virtio_send_offchannel_raw skip rvdev->shbuf_io metal_io_block_write
                default n
            
            config USE_MASTER_VRING_DEFINE
                bool
                prompt "Use the Vring definition in the master"
                default n

            	menu "Baremetal config"
            
            choice
            prompt "Select mem default attribute"
            default MEM_NO_CACHE
            config MEM_NO_CACHE
                bool "Outer and Inner Non-cacheable , Outer Shareable"
            config MEM_WRITE_THROUGH
                bool "Outer and Inner Write-Through, Read-Allocate No Write-Allocate , Outer Shareable"
            config MEM_NORMAL
                bool "Outer and Inner Write-Back, Read-Allocate Write-Allocate , Outer Shareable"
            endchoice
	endmenu 


        endif

endmenu
```

## sourcecode/slavedevice/standalone/third-party/sdmmc/Kconfig
```kconfig
menu "Sdmmc configuration"
    config SDMMC_USE_FSDMMC        
        bool "Fsdmmc"
        select USE_SDMMC
        select ENABLE_FSDMMC

    config SDMMC_USE_FSDIO
        bool "Fsdio"
        select USE_SDMMC
        select ENABLE_FSDIO
endmenu
```

## sourcecode/slavedevice/standalone/third-party/spiffs-0.3.7/Kconfig
```kconfig
menu "Spiffs configuration"

config SPIFFS_ON_FSPIM_SFUD
    bool
    prompt "Use fspim(sfud)"        
    select USE_SPI
    select USE_FSPIM
    select SFUD_CTRL_FSPIM
    default n

config SPIFFS_ON_FQSPI_SFUD
    bool
    prompt "Use FQSPI(sfud)"        
    select USE_QSPI
    select USE_FQSPI
    select SFUD_CTRL_FQSPI
    default n

endmenu
```

## sourcecode/slavedevice/standalone/tools/build/ld/Kconfig
```kconfig
# entry of menuconfig

menu "Linker Options"

    choice 
        prompt "Select Linker Script Template"
        optional
        default DEFAULT_LINKER_SCRIPT

        config DEFAULT_LINKER_SCRIPT
            bool "Use sdk default linker script"
            help
                Use linkscript for booting AARCH32 Baremetal Image from DDR

        config USER_DEFINED_LD
            bool "User defined link script"
            help
                Use other link script provided by User
    endchoice

if DEFAULT_LINKER_SCRIPT
    config IMAGE_LOAD_ADDRESS
        hex "Image load address"
        default "0x80100000"
        range 0x80100000 0xFFFFFFFFFFF if ARCH_ARMV8_AARCH64
        range 0x80100000 0xFFFFFFFF if ARCH_ARMV8_AARCH32
        depends on DEFAULT_LINKER_SCRIPT
        help
        This option specifies the load address of the image.
        The address should be a 64-bit hexadecimal value.

    config IMAGE_MAX_LENGTH
        hex "Maximum image length (in bytes)"
        default 0x1000000
        depends on DEFAULT_LINKER_SCRIPT
        help
        This option specifies the maximum length of the image, in bytes.
        The length should be a 32-bit integer value.

    config HEAP_SIZE
        int "Heap Size (MB)"
        default "1"
        help
            Assign Heap size in Linkscript

    config STACK_SIZE
        hex "Stack Size (Byte)"
        default "0x400"
        depends on ARCH_ARMV8_AARCH64
        help
            Assign Stack size in Linkscript  

    config FPU_STACK_SIZE
        hex "Fpu stack Size (Byte)"
        default "0x1000"
        depends on ARCH_ARMV8_AARCH64
        help
            Assign Fpu stack size in Linkscript

    config SVC_STACK_SIZE
        hex "Aarch32 supervisor stack size (Byte)"
        default "0x1000"
        depends on ARCH_ARMV8_AARCH32
        help
            Assign Stack size in Linkscript  

    config SYS_STACK_SIZE
        hex "Aarch32 system stack size (Byte)"
        default "0x1000"
        depends on ARCH_ARMV8_AARCH32
        help
            Assign system stack size in Linkscript  
    
    config IRQ_STACK_SIZE
        hex "Aarch32 Irq stack size (Byte)"
        default "0x1000"
        depends on ARCH_ARMV8_AARCH32
        help
            Assign Irq stack size in Linkscript  
    
    config ABORT_STACK_SIZE
        hex "Aarch32 abort stack size (Byte)"
        default "0x1000"
        depends on ARCH_ARMV8_AARCH32
        help
            Assign abort stack size in Linkscript  

    config FIQ_STACK_SIZE
        hex "Aarch32 fiq stack size (Byte)"
        default "0x1000"
        depends on ARCH_ARMV8_AARCH32
        help
            Assign abort stack size in Linkscript  
    
    config UNDEF_STACK_SIZE
        hex "Aarch32 undef stack size (Byte)"
        default "0x1000"
        depends on ARCH_ARMV8_AARCH32
        help
            Assign undef stack size in Linkscript 
endif
endmenu
```

## sourcecode/slavedevice/third-party/Kconfig
```kconfig
config USE_LWIP
    bool
    prompt "Use LWIP"
    help
        Include LWIP for Network Protocol

    if USE_LWIP
        source "$(FREERTOS_SDK_ROOT)/third-party/lwip-2.1.2/Kconfig"
    endif


config USE_BACKTRACE
    bool
    prompt "Display a backtrace."
    default y

config USE_FATFS_0_1_4
    bool
    prompt "Use FATFS(0.1.4)"
    default n
    help
        Include FATFS

    if USE_FATFS_0_1_4
        source "$(FREERTOS_SDK_ROOT)/third-party/fatfs-0.1.4/Kconfig"
    endif

config USE_SFUD
    bool
    prompt "Use SFUD(Spi Flash Library)"
    default n
    help
        Include JEDEC SFDP standard serial (SPI) flash universal driver library

    if USE_SFUD
        source "$(FREERTOS_SDK_ROOT)/third-party/sfud-1.1.0/Kconfig"
    endif

config USE_SPIFFS
    bool
    default n
    prompt "Use Spiffs"
    help
        Include Spiffs as SPI Flash File System

    if USE_SPIFFS
        source "$(FREERTOS_SDK_ROOT)/third-party/spiffs-0.3.7/Kconfig"
    endif


config USE_AMP
    bool
    prompt "Use Asymmetric Multi-processing"
    default n
    help
        Include OpenAMP framework

    if USE_AMP
        config USE_LIBMETAL
            bool
            prompt "Use Libmetal"
            help
                Include Libmetal

        source "$(FREERTOS_SDK_ROOT)/third-party/openamp/ports/Kconfig"

    endif


config USE_LETTER_SHELL
    bool
    prompt "Use Letter Shell"
    default n
    help
        Include Litter Shell for User Interactive

    if USE_LETTER_SHELL
        source "$(FREERTOS_SDK_ROOT)/third-party/letter-shell-3.1/Kconfig"
    endif

config USE_TLSF
    bool
    prompt "Use TLSF"
    default n
    help
        Include TLSF for memory pool

config USE_SDMMC_CMD
    bool
    prompt "Use Sd/MMC/SDIO/eMMc Cmd"
    default n
    help
        Include Sd/MMC/SDIO/eMMc Command framework

    if USE_SDMMC_CMD
        source "$(FREERTOS_SDK_ROOT)/third-party/sdmmc-1.0/Kconfig"
    endif

config USE_CHERRY_USB
    bool
    default n
    prompt "Use CherryUSB(0.8.0)"
    help
        Include CherryUSB for XHCI controller

    if USE_CHERRY_USB
        source "$(FREERTOS_SDK_ROOT)/third-party/cherryusb/Kconfig"
    endif

config USE_LVGL
    bool
    default n
    prompt "Use LVGL"
    help
        Include LVGL

    if USE_LVGL
        source "$(FREERTOS_SDK_ROOT)/third-party/lvgl-8.3/Kconfig"
    endif
```
